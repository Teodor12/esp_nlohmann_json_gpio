## main/Kconfig.projbuild
```kconfig
menu "Wifi configuration"

    config ESP_WIFI_SSID
        string "WiFi SSID"
        default "myssid"
        help
            SSID (network name) to connect to

    config ESP_WIFI_PASSWORD
        string "WiFi Password"
        default "mypassword"
        help
            WiFi password (WPA or WPA2) for the SSID
endmenu

menu "GPIO pin configuration"

    config GPIO_PIN1_NUMBER
        int "Pin number for the first configurable GPIO pin"
        range 0 39
        default 25
        help
            GPIO pin number for output 1. Valid range 0-39.

    config GPIO_PIN2_NUMBER
        int "Pin number for the second configurable GPIO pin"
        range 0 39
        default 26
        help
            GPIO pin number for output 2. Valid range 0-39.

    config GPIO_PIN3_NUMBER
        int "Pin number for the third configurable GPIO pin"
        range 0 39
        default 27
        help
            GPIO pin number for output 2. Valid range 0-39.
endmenu

menu "MQTT configuration"

    config MQTT_BROKER_IP
        string "MQTT broker IP-address"
        default "0.0.0.0"
        help
            IP-address of MQTT_BROKER

    config MQTT_BROKER_PORT
        int "MQTT broker IP-address"
        default 1883
        help
            Port of MQTT_BROKER

    config MQTT_BROKER_TOPIC
            string "MQTT broker topic"
            default "default_topic"
            help
                Topic of MQTT_BROKER to subscribe to
endmenu
```
